#pragma once

// On-flash layout of the data-partition web asset pack (`CWP1`), plus every
// check a reader runs before trusting a byte of it.
//
// Generated by scripts/build_web_pack.py into build/web_pack.dat and written to
// the data/spiffs partition by exp/flash_device.sh. Read Pico is the only target
// that uses it (CROSSPOINT_WEB_ASSETS_FROM_PARTITION): its app0 has no room for
// the ~154 KB of gzip'd pages, so the web server reads them from flash instead.
// Every other target keeps the `*.generated.h` arrays embedded.
//
// Why the pack carries a schema signature: the bytes are gzip streams whose
// names and meanings live only in the firmware. A pack left on the partition by
// an older firmware would still pass magic/version/CRC and would then be served
// as if it were current -- stale forms posting to endpoints that no longer
// exist. The signature is an FNV-1a64 of (version, count, each id/size/crc32),
// written into src/network/WebPackSchema.generated.h at build time and compared
// at load time. A mismatch rejects the whole pack; it is never partially used.
//
// Layout, little-endian, every asset 4-byte aligned:
//
//   header   32 bytes (Header)
//   index    entryCount * 20 bytes (Entry)
//   data     each asset's gzip payload
//
// Deliberately free of HAL and ESP headers so the format can be validated on
// the host. The partition reader lives in WebAssets.cpp.

#include <cstddef>
#include <cstdint>
#include <cstring>

namespace web_pack {

inline constexpr char WEB_PACK_MAGIC[4] = {'C', 'W', 'P', '1'};
inline constexpr uint8_t WEB_PACK_VERSION = 1;
inline constexpr size_t WEB_PACK_HEADER_SIZE = 32;
inline constexpr size_t WEB_PACK_ENTRY_SIZE = 20;

// Caps, not expectations: they bound the arithmetic so a corrupt header cannot
// make the loader allocate or read an absurd amount. Six assets ship today and
// the pack is ~154 KB.
inline constexpr uint32_t WEB_PACK_MAX_ENTRIES = 16;
inline constexpr uint32_t WEB_PACK_MAX_TOTAL = 1u << 20;

// Partition-relative offset inside data/spiffs. Single source of truth:
// scripts/generate_data_manifest.py reads this constant (as text) to build
// data_manifest.txt, so the manifest and the loader cannot drift.
//
// 0x56000 sits between the pinyin table (0..0x5553C) and the twelve reserved
// factory bytes at 0x80000, ending at 0x7C8B4. It is deliberately NOT after the
// language pack any more: the language pack is the blob that grows (every new key
// adds bytes to the 33 packed languages that carry a translation), so it has to be last on the
// partition, with the whole tail free. At 0x153000 the web pack left it ~3 KB.
// The manifest generator reads this constant, so flashes and the layout agree.
inline constexpr uint32_t WEB_PACK_PARTITION_OFFSET = 0x56000;

// Asset ids. Stable: they are part of the schema signature, and the tools and
// the index compare on them. Append new pages; do not renumber.
enum AssetId : uint32_t {
  WEB_ASSET_FILES_PAGE_EN = 1,
  WEB_ASSET_FILES_PAGE_ZH = 2,
  WEB_ASSET_SETTINGS_PAGE_EN = 3,
  WEB_ASSET_SETTINGS_PAGE_ZH = 4,
  WEB_ASSET_JSZIP = 5,
  WEB_ASSET_PLUGIN_RUNNER = 6,
};
inline constexpr uint32_t WEB_PACK_ASSET_COUNT = 6;

enum class Validity : uint8_t {
  Ok = 0,
  TooSmall,
  BadMagic,
  BadVersion,
  HeaderSize,
  EntryCount,
  TotalSize,
  IndexBounds,
  BadIndexCrc,
  EntryBounds,
  DuplicateId,
  SchemaMismatch,
  BadEntryCrc,
  // Loader-side reasons: the bytes may be fine, but the pack cannot be used.
  NoPartition,
  PartitionRead,
  PsramStack,
  OutOfMemory,
};

inline const char* validityName(Validity value) {
  switch (value) {
    case Validity::Ok: return "ok";
    case Validity::TooSmall: return "shorter than a header";
    case Validity::BadMagic: return "not a web pack (bad magic)";
    case Validity::BadVersion: return "unsupported pack version";
    case Validity::HeaderSize: return "header or entry size mismatch";
    case Validity::EntryCount: return "implausible asset count";
    case Validity::TotalSize: return "pack size disagrees with the partition";
    case Validity::IndexBounds: return "index extends past the pack";
    case Validity::BadIndexCrc: return "index CRC mismatch";
    case Validity::EntryBounds: return "an entry points outside the pack, is unaligned, or overlaps";
    case Validity::DuplicateId: return "duplicate asset id in the index";
    case Validity::SchemaMismatch: return "built by a different firmware (schema signature mismatch)";
    case Validity::BadEntryCrc: return "asset CRC mismatch";
    case Validity::NoPartition: return "no data partition";
    case Validity::PartitionRead: return "partition read failed";
    case Validity::PsramStack: return "refused on a PSRAM-stack task";
    case Validity::OutOfMemory: return "PSRAM allocation failed";
  }
  return "unknown";
}

#pragma pack(push, 1)
struct Header {
  char magic[4];
  uint8_t version;
  uint8_t headerSize;
  uint16_t entryCount;
  uint32_t totalSize;  // whole pack, header and index included
  uint16_t entrySize;
  uint32_t indexCrc32;    // CRC-32 over the index bytes (zlib.crc32)
  uint64_t schemaSignature;  // FNV-1a64, see WebPackSchema.generated.h
  uint8_t reserved[6];
};

struct Entry {
  uint32_t id;
  uint32_t offset;  // absolute pack offset, 4-byte aligned
  uint32_t size;
  uint32_t crc32;  // over the gzip payload
  uint32_t reserved;
};
#pragma pack(pop)

static_assert(sizeof(Header) == WEB_PACK_HEADER_SIZE, "Header must stay 32 bytes");
static_assert(sizeof(Entry) == WEB_PACK_ENTRY_SIZE, "Entry must stay 20 bytes");

// Byte-at-a-time reflected CRC-32 (IEEE 802.3, the polynomial zlib uses), so
// the generator's zlib.crc32 and this agree without either side carrying a
// table. The largest asset hashed here is 54 KB once per web-server start, so a
// 1 KiB lookup table would cost more than it saves.
inline uint32_t crc32(const uint8_t* data, size_t size, uint32_t running = 0xFFFFFFFFu) {
  for (size_t i = 0; i < size; ++i) {
    running ^= data[i];
    for (int bit = 0; bit < 8; ++bit) {
      running = (running >> 1) ^ (0xEDB88320u & (0u - (running & 1u)));
    }
  }
  return running;
}

inline uint32_t crc32Final(uint32_t running) { return running ^ 0xFFFFFFFFu; }

inline size_t expectedIndexBytes(uint32_t entryCount) {
  return static_cast<size_t>(entryCount) * WEB_PACK_ENTRY_SIZE;
}

// Header validation. `available` is how many bytes the caller actually holds;
// `partitionBytes` is how much room remains in the data partition from the
// pack's offset. Structural checks first, then the build-identity comparison is
// done in validateSchema() because it needs the index.
inline Validity validateHeader(const uint8_t* data, size_t available, uint32_t partitionBytes, Header& out) {
  out = Header{};
  if (data == nullptr || available < WEB_PACK_HEADER_SIZE) return Validity::TooSmall;

  Header header;
  memcpy(&header, data, sizeof(header));
  if (memcmp(header.magic, WEB_PACK_MAGIC, sizeof(WEB_PACK_MAGIC)) != 0) return Validity::BadMagic;
  if (header.version != WEB_PACK_VERSION) return Validity::BadVersion;
  if (header.headerSize != WEB_PACK_HEADER_SIZE || header.entrySize != WEB_PACK_ENTRY_SIZE) {
    return Validity::HeaderSize;
  }
  if (header.entryCount == 0 || header.entryCount > WEB_PACK_MAX_ENTRIES) return Validity::EntryCount;

  const size_t indexEnd = WEB_PACK_HEADER_SIZE + expectedIndexBytes(header.entryCount);
  if (header.totalSize < indexEnd || header.totalSize > WEB_PACK_MAX_TOTAL) return Validity::TotalSize;
  if (header.totalSize > partitionBytes) return Validity::TotalSize;

  out = header;
  return Validity::Ok;
}

// Index validation. Every entry must describe a 4-aligned region wholly inside
// the pack and above the index, no two entries may overlap, and no id may repeat
// (a duplicate would make the served page depend on index order, which a reader
// of the file cannot see).
inline Validity validateIndex(const Header& header, const uint8_t* data, size_t available) {
  const size_t indexBytes = expectedIndexBytes(header.entryCount);
  if (data == nullptr || available < indexBytes) return Validity::IndexBounds;
  if (crc32Final(crc32(data, indexBytes)) != header.indexCrc32) return Validity::BadIndexCrc;

  const size_t indexEnd = WEB_PACK_HEADER_SIZE + indexBytes;
  const size_t dataStart = (indexEnd + 3u) & ~static_cast<size_t>(3u);

  for (uint32_t i = 0; i < header.entryCount; ++i) {
    Entry entry;
    memcpy(&entry, data + static_cast<size_t>(i) * WEB_PACK_ENTRY_SIZE, sizeof(entry));
    if ((entry.offset & 3u) != 0) return Validity::EntryBounds;
    if (entry.offset < dataStart) return Validity::EntryBounds;
    const uint64_t end = static_cast<uint64_t>(entry.offset) + entry.size;
    if (end > header.totalSize) return Validity::EntryBounds;
    for (uint32_t j = 0; j < i; ++j) {
      Entry earlier;
      memcpy(&earlier, data + static_cast<size_t>(j) * WEB_PACK_ENTRY_SIZE, sizeof(earlier));
      if (earlier.id == entry.id) return Validity::DuplicateId;
      // Empty assets cannot overlap anything, and the generator never emits them.
      if (entry.size == 0 || earlier.size == 0) continue;
      const uint64_t earlierEnd = static_cast<uint64_t>(earlier.offset) + earlier.size;
      if (entry.offset < earlierEnd && earlier.offset < end) return Validity::EntryBounds;
    }
  }
  return Validity::Ok;
}

// FNV-1a64 of (format version, entry count, each entry's id/size/crc32), in
// index order. Must match scripts/web_assets.py::schema_signature byte for byte.
// Offsets are deliberately excluded: relayouting the pack without changing any
// asset bytes is compatible, while a pack built from different page bytes is not.
inline uint64_t computeSchemaSignature(const Header& header, const uint8_t* index) {
  uint64_t value = 0xCBF29CE484222325ull;
  const auto feed = [&value](const uint8_t* bytes, size_t size) {
    for (size_t i = 0; i < size; ++i) {
      value ^= bytes[i];
      value *= 0x100000001B3ull;
    }
  };
  const uint8_t version = WEB_PACK_VERSION;
  const uint8_t countBytes[2] = {static_cast<uint8_t>(header.entryCount & 0xFFu),
                                 static_cast<uint8_t>((header.entryCount >> 8) & 0xFFu)};
  feed(&version, 1);
  feed(countBytes, sizeof(countBytes));
  for (uint32_t i = 0; i < header.entryCount; ++i) {
    Entry entry;
    memcpy(&entry, index + static_cast<size_t>(i) * WEB_PACK_ENTRY_SIZE, sizeof(entry));
    const uint32_t row[3] = {entry.id, entry.size, entry.crc32};
    for (uint32_t field : row) {
      const uint8_t le[4] = {static_cast<uint8_t>(field & 0xFFu), static_cast<uint8_t>((field >> 8) & 0xFFu),
                             static_cast<uint8_t>((field >> 16) & 0xFFu),
                             static_cast<uint8_t>((field >> 24) & 0xFFu)};
      feed(le, sizeof(le));
    }
  }
  return value;
}

inline Validity validateSchema(const Header& header, const uint8_t* index, size_t available,
                               uint64_t expectedSignature) {
  if (index == nullptr || available < expectedIndexBytes(header.entryCount)) return Validity::IndexBounds;
  if (computeSchemaSignature(header, index) != expectedSignature) return Validity::SchemaMismatch;
  return Validity::Ok;
}

inline bool findEntry(const uint8_t* index, uint32_t count, uint32_t id, Entry& out) {
  for (uint32_t i = 0; i < count; ++i) {
    memcpy(&out, index + static_cast<size_t>(i) * WEB_PACK_ENTRY_SIZE, sizeof(out));
    if (out.id == id) return true;
  }
  return false;
}

inline Validity validateEntry(const Entry& entry, const uint8_t* data, size_t available) {
  if (data == nullptr && entry.size != 0) return Validity::EntryBounds;
  if (available < entry.size) return Validity::EntryBounds;
  if (crc32Final(crc32(data, entry.size)) != entry.crc32) return Validity::BadEntryCrc;
  return Validity::Ok;
}

}  // namespace web_pack
