#pragma once

// On-disk layout of `/hyphen.dat` -- the container that carries the eleven Liang
// hyphenation tries out of the firmware image -- and every check a reader runs
// before trusting a byte of it.
//
// Generated by scripts/generate_hyphenation_db.py from the same
// `lib/Epub/Epub/hyphenation/generated/hyph-*.trie.h` headers the firmware used to
// compile in, so the bytes are identical by construction and the data-format test
// asserts exactly that.
//
// The card is user-writable and the file can also be uploaded through the web file
// manager, so a valid header is not a promise. Bounds are checked here once per
// load; the automaton itself is bounds-checked per node while walking
// (LiangHyphenation.cpp decodeState), and the CRC catches bit rot that structure
// cannot. A trie parsed against the wrong automaton layout would not crash -- it
// would silently hyphenate words in the wrong places, which is why magic and
// version are mandatory and why a mismatch is a loud refusal rather than a guess.
//
// Layout, little-endian, every blob 4-byte aligned:
//
//   header   64 bytes (HyphHeader)
//   index    entryCount * 20 bytes (HyphEntry), immediately after the header
//   blobs    the trie bytes, concatenated, each padded to a 4-byte boundary
//
// Deliberately free of HAL and ESP headers so the whole layout is host-testable.

#include <cstddef>
#include <cstdint>
#include <cstring>

#include "SerializedHyphenationTrie.h"

namespace hyphenation {

// SD card root, visible on purpose: installing the file is a copy, and a visible
// name is the only one a phone or Windows user can drop onto the card. Same
// reasoning as /pinyin.dat.
inline constexpr char HYPHEN_DB_PATH[] = "/hyphen.dat";

inline constexpr char HYPN_MAGIC[4] = {'H', 'Y', 'P', 'N'};
inline constexpr uint8_t HYPN_VERSION = 1;
inline constexpr size_t HYPN_HEADER_SIZE = 64;
inline constexpr size_t HYPN_ENTRY_SIZE = 20;
inline constexpr size_t HYPN_INDEX_OFFSET = HYPN_HEADER_SIZE;

// Caps, not expectations: they bound the arithmetic below so a corrupt header
// cannot make the loader allocate or read an absurd amount. Eleven languages ship
// today; the largest trie (German) is 206,259 bytes.
inline constexpr uint32_t HYPN_MAX_ENTRIES = 16;
inline constexpr size_t HYPN_MIN_BLOB = 8;
inline constexpr size_t HYPN_MAX_BLOB = 1u << 22;
inline constexpr size_t HYPN_MAX_FILE = 1u << 23;

enum class HyphValidity : uint8_t {
  Ok = 0,
  TooSmall,
  BadMagic,
  BadVersion,
  TotalSize,
  EntryCount,
  BlobsOffset,
  BadIndexCrc,
  EntryBounds,
  BlobBounds,
  BadBlobCrc,
  RootOffset,
  BlobSize,
  TooLarge,
};

inline const char* hyphValidityName(HyphValidity v) {
  switch (v) {
    case HyphValidity::Ok: return "ok";
    case HyphValidity::TooSmall: return "shorter than a header";
    case HyphValidity::BadMagic: return "not a hyphenation container (bad magic)";
    case HyphValidity::BadVersion: return "unsupported container version";
    case HyphValidity::TotalSize: return "header size disagrees with the file";
    case HyphValidity::EntryCount: return "implausible language count";
    case HyphValidity::BlobsOffset: return "implausible blob section offset";
    case HyphValidity::BadIndexCrc: return "header or index CRC mismatch";
    case HyphValidity::EntryBounds: return "an entry points outside the file";
    case HyphValidity::BlobBounds: return "blob length disagrees with the file";
    case HyphValidity::BadBlobCrc: return "blob CRC mismatch";
    case HyphValidity::RootOffset: return "root offset outside the blob";
    case HyphValidity::BlobSize: return "implausible blob size";
    case HyphValidity::TooLarge: return "container larger than this build accepts";
  }
  return "unknown";
}

#pragma pack(push, 1)
struct HyphHeader {
  char magic[4];
  uint8_t version;
  uint8_t reserved[3];
  uint32_t totalSize;
  // CRC-32 (IEEE, reflected -- the same value zlib.crc32 produces) over the header
  // with this field read as zero, followed by the index bytes. Hashing the index
  // too is what makes a reordered or truncated language table detectable rather
  // than merely odd.
  uint32_t indexCrc32;
  uint32_t entryCount;
  uint32_t blobsOff;
  uint32_t reserved2[10];
};

struct HyphEntry {
  // ISO 639-1 primary subtag, exactly the two letters LanguageRegistry keys on.
  char lang[2];
  uint8_t reserved[2];
  // Value that used to be the first member of the generated `<lang>_patterns`
  // descriptor. It is hypher's root address minus the 4-byte root header the
  // generator strips, and LiangHyphenation adds the 4 back when it indexes the
  // levels tape.
  uint32_t rootOffset;
  uint32_t blobOff;  // absolute file offset, 4-byte aligned
  uint32_t blobSize;
  uint32_t blobCrc32;
};
#pragma pack(pop)

static_assert(sizeof(HyphHeader) == HYPN_HEADER_SIZE, "HyphHeader must stay 64 bytes");
static_assert(sizeof(HyphEntry) == HYPN_ENTRY_SIZE, "HyphEntry must stay 20 bytes");

// Byte-at-a-time reflected CRC-32 (IEEE 802.3, the polynomial zlib uses), so the
// generator's `zlib.crc32` and this agree without either side carrying a table.
// A 1 KiB lookup table would be faster and cost 1 KiB of .rodata; the whole point
// of this file is to give .rodata back, and the largest blob hashed here is
// 206 KB once per language switch, so the table is not worth its own weight.
inline uint32_t hyphCrc32(const uint8_t* data, size_t size, uint32_t running = 0xFFFFFFFFu) {
  for (size_t i = 0; i < size; ++i) {
    running ^= data[i];
    for (int bit = 0; bit < 8; ++bit) {
      running = (running >> 1) ^ (0xEDB88320u & (0u - (running & 1u)));
    }
  }
  return running;
}

inline uint32_t hyphCrc32Final(uint32_t running) { return running ^ 0xFFFFFFFFu; }

// Bytes covered by HyphHeader::indexCrc32: the header with that field read as
// zero, then the index. Both halves are hashed in one pass so the caller cannot
// forget the second.
inline uint32_t hyphIndexCrc(const uint8_t* data, size_t headerAndIndexBytes) {
  const size_t crcField = offsetof(HyphHeader, indexCrc32);
  static const uint8_t kZeroes[sizeof(uint32_t)] = {0, 0, 0, 0};
  uint32_t running = hyphCrc32(data, crcField);
  running = hyphCrc32(kZeroes, sizeof(kZeroes), running);
  running = hyphCrc32(data + crcField + sizeof(kZeroes), headerAndIndexBytes - crcField - sizeof(kZeroes), running);
  return hyphCrc32Final(running);
}

// Header + index validation. `available` is how many bytes the caller actually
// holds; the container may legitimately be longer (a loader that read only the
// header and index passes their extent here).
inline HyphValidity hyphValidateIndex(const uint8_t* data, const size_t available, uint32_t& entryCountOut) {
  entryCountOut = 0;
  if (data == nullptr || available < HYPN_HEADER_SIZE) return HyphValidity::TooSmall;

  HyphHeader header;
  memcpy(&header, data, sizeof(header));
  if (memcmp(header.magic, HYPN_MAGIC, sizeof(HYPN_MAGIC)) != 0) return HyphValidity::BadMagic;
  if (header.version != HYPN_VERSION) return HyphValidity::BadVersion;
  if (header.entryCount == 0 || header.entryCount > HYPN_MAX_ENTRIES) return HyphValidity::EntryCount;

  const size_t indexBytes = static_cast<size_t>(header.entryCount) * HYPN_ENTRY_SIZE;
  const size_t indexEnd = HYPN_INDEX_OFFSET + indexBytes;
  // blobsOff is derived, not trusted: it must be the index end rounded up to the
  // alignment the blobs are written at. Accepting an arbitrary value would let a
  // crafted header overlap the index with a blob.
  const size_t expectedBlobs = (indexEnd + 3u) & ~static_cast<size_t>(3u);
  if (header.blobsOff != expectedBlobs) return HyphValidity::BlobsOffset;
  if (header.totalSize < expectedBlobs || header.totalSize > HYPN_MAX_FILE) return HyphValidity::TotalSize;
  if (available < indexEnd) return HyphValidity::TooSmall;
  if (header.indexCrc32 != hyphIndexCrc(data, indexEnd)) return HyphValidity::BadIndexCrc;

  // Every entry must describe a 4-aligned blob wholly inside the file, and no two
  // may share a language: a duplicate would make the loader's choice depend on
  // index order, which is not something a reader of this file can see.
  for (uint32_t i = 0; i < header.entryCount; ++i) {
    HyphEntry entry;
    memcpy(&entry, data + HYPN_INDEX_OFFSET + static_cast<size_t>(i) * HYPN_ENTRY_SIZE, sizeof(entry));
    if (entry.blobSize < HYPN_MIN_BLOB || entry.blobSize > HYPN_MAX_BLOB) return HyphValidity::BlobSize;
    if ((entry.blobOff & 3u) != 0 || entry.blobOff < header.blobsOff) return HyphValidity::EntryBounds;
    const uint64_t end = static_cast<uint64_t>(entry.blobOff) + entry.blobSize;
    if (end > header.totalSize) return HyphValidity::EntryBounds;
    if (entry.rootOffset >= entry.blobSize) return HyphValidity::RootOffset;
    for (uint32_t j = 0; j < i; ++j) {
      HyphEntry earlier;
      memcpy(&earlier, data + HYPN_INDEX_OFFSET + static_cast<size_t>(j) * HYPN_ENTRY_SIZE, sizeof(earlier));
      if (memcmp(earlier.lang, entry.lang, sizeof(entry.lang)) == 0) return HyphValidity::EntryBounds;
    }
  }

  entryCountOut = header.entryCount;
  return HyphValidity::Ok;
}

// Finds one language's entry. `index` points at the first HyphEntry and
// `entryCount` is the value hyphValidateIndex produced.
inline bool hyphFindEntry(const uint8_t* index, const uint32_t entryCount, const char lang2[2], HyphEntry& out) {
  for (uint32_t i = 0; i < entryCount; ++i) {
    memcpy(&out, index + static_cast<size_t>(i) * HYPN_ENTRY_SIZE, sizeof(out));
    if (out.lang[0] == lang2[0] && out.lang[1] == lang2[1]) return true;
  }
  return false;
}

// Validates one blob the caller has already read. `available` is how many bytes
// are actually in the buffer, which is how a short read is caught instead of
// being hashed as if it were complete.
inline HyphValidity hyphValidateBlob(const HyphEntry& entry, const uint8_t* blob, const size_t available) {
  if (blob == nullptr || available < entry.blobSize) return HyphValidity::BlobBounds;
  if (entry.blobSize < HYPN_MIN_BLOB || entry.blobSize > HYPN_MAX_BLOB) return HyphValidity::BlobSize;
  if (entry.rootOffset >= entry.blobSize) return HyphValidity::RootOffset;
  if (hyphCrc32Final(hyphCrc32(blob, entry.blobSize)) != entry.blobCrc32) return HyphValidity::BadBlobCrc;
  return HyphValidity::Ok;
}

}  // namespace hyphenation
