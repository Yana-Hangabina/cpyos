#pragma once

// On-disk layout of the Pinyin database (`pinyin.dat` on the SD card root) and
// the validation every reader runs before trusting a byte of it.
//
// The file is generated by scripts/generate_pinyin_db.py from the pinned
// pypinyin wheel; the firmware carries no Pinyin data of its own because the
// full table (about 349 KB) does not fit the flash budget. The card is
// user-writable, so a valid header is not a promise: section bounds are checked
// here once, indices derived from the tables are clamped at use, and the CRC
// catches bit rot that structure cannot.
//
// Layout, little-endian, every section 4-byte aligned:
//
//   header         96 bytes (PydbHeader)
//   codepoints     u32[codepointCount], ascending: character
//   groups         u16[codepointCount]: reading-group id per character
//   group_offsets  u16[groupCount + 1]: group -> range in `readings`
//   readings       u16[readingCount]: syllable ids of a group
//   syllable_offsets u16[syllableCount + 1]: syllable -> offset in `syllables`
//   syllables      NUL-terminated syllable strings, concatenated
//   ime_offsets    u32[syllableCount + 1]: syllable -> range in `ime_chars`
//   ime_chars      u16[imeCharCount]: candidates, common glyphs first
//   phrase_offsets u32[phraseCount + 1]: phrase -> offset in `phrases`
//   phrases        "roman\0text\0" repeated
//
// Deliberately free of HAL and ESP headers so the whole layout is host-testable.

#include <cstddef>
#include <cstdint>
#include <cstring>

namespace pinyin {

// SD card root, visible on purpose: installing the file is a copy, and a
// visible name is the only one Windows users can drop onto the card.
inline constexpr char PINYIN_DB_PATH[] = "/pinyin.dat";

inline constexpr char PYDB_MAGIC[4] = {'P', 'Y', 'D', 'B'};
inline constexpr uint8_t PYDB_VERSION = 1;
inline constexpr size_t PYDB_HEADER_SIZE = 96;

// Generous caps, not expectations: they bound the section arithmetic below.
inline constexpr uint32_t PYDB_MAX_CODEPOINTS = 1 << 20;
inline constexpr uint32_t PYDB_MAX_GROUPS = 1 << 20;
inline constexpr uint32_t PYDB_MAX_READINGS = 1 << 21;
inline constexpr uint32_t PYDB_MAX_SYLLABLES = 1 << 14;
inline constexpr uint32_t PYDB_MAX_IME_CHARS = 1 << 21;
inline constexpr uint32_t PYDB_MAX_PHRASES = 1 << 16;
inline constexpr uint32_t PYDB_MAX_BLOB = 1 << 22;

#pragma pack(push, 1)
struct PydbHeader {
  char magic[4];
  uint8_t version;
  uint8_t reserved[3];
  uint32_t totalSize;
  // CRC-32 (IEEE, reflected) over the complete file with this field read as
  // zero. The generator hashes the image before patching the field in, so both
  // sides must zero it before hashing.
  uint32_t crc32;
  uint32_t codepointCount;
  uint32_t groupCount;
  uint32_t readingCount;
  uint32_t syllableCount;
  uint32_t imeCharCount;
  uint32_t phraseCount;
  uint32_t codepointsOff;
  uint32_t groupsOff;
  uint32_t groupOffsetsOff;
  uint32_t readingsOff;
  uint32_t syllableOffsetsOff;
  uint32_t syllablesOff;
  uint32_t syllablesLen;
  uint32_t imeOffsetsOff;
  uint32_t imeCharsOff;
  uint32_t phraseOffsetsOff;
  uint32_t phraseBlobOff;
  uint32_t phraseBlobLen;
  uint32_t reserved2;
  uint32_t reserved3;
};
static_assert(sizeof(PydbHeader) == PYDB_HEADER_SIZE, "PydbHeader must be exactly 96 bytes");
#pragma pack(pop)

enum class PydbValidity : uint8_t {
  Ok,
  TooSmall,
  BadMagic,
  UnknownVersion,
  SizeMismatch,
  SectionsInconsistent,
  BadCrc,
};

const char* pydbValidityName(PydbValidity validity);

// Table-free CRC-32 to keep flash at zero; the 256-entry table is built on
// first use. The image is hashed once per session at load time.
inline const uint32_t* pydbCrc32Table() {
  static uint32_t table[256];
  static bool haveTable = false;
  if (!haveTable) {
    for (uint32_t i = 0; i < 256; i++) {
      uint32_t c = i;
      for (int k = 0; k < 8; k++) c = (c & 1) ? 0xEDB88320u ^ (c >> 1) : c >> 1;
      table[i] = c;
    }
    haveTable = true;
  }
  return table;
}

// Incremental so the CRC field can be substituted with zero without copying
// the 349 KB image.
struct PydbCrc {
  uint32_t state = 0xFFFFFFFFu;

  void update(const uint8_t* data, size_t size) {
    const uint32_t* table = pydbCrc32Table();
    for (size_t i = 0; i < size; i++) state = table[(state ^ data[i]) & 0xFF] ^ (state >> 8);
  }
  uint32_t value() const { return state ^ 0xFFFFFFFFu; }
};

// Hashes [0, crc field) and [crc field end, size) with the field read as zero.
inline uint32_t pydbCrc32WithFieldZeroed(const uint8_t* data, const size_t size) {
  constexpr size_t kCrcOffset = offsetof(PydbHeader, crc32);
  const uint8_t zero[4] = {0, 0, 0, 0};
  PydbCrc crc;
  crc.update(data, kCrcOffset);
  crc.update(zero, sizeof(zero));
  crc.update(data + kCrcOffset + sizeof(zero), size - kCrcOffset - sizeof(zero));
  return crc.value();
}

namespace detail {

inline bool pydbRangeFits(uint32_t offset, uint64_t bytes, uint64_t totalSize) {
  return offset >= PYDB_HEADER_SIZE && (offset & 3u) == 0 && bytes <= totalSize && offset <= totalSize - bytes;
}

}  // namespace detail

// Header-only check for a database burnt into a flash data partition (the
// flasher writes the same file, header first). Confirms the magic, the version
// and that the promised size fits the partition, so the caller can size and
// fill its buffer before the file has been read. The CRC still runs later,
// over the whole image, through validatePydb().
inline PydbValidity checkBundledPydbHeader(const uint8_t* header, const size_t headerSize, const size_t partitionSize,
                                           size_t& totalSize) {
  if (header == nullptr || headerSize < PYDB_HEADER_SIZE) return PydbValidity::TooSmall;
  PydbHeader h;
  memcpy(&h, header, sizeof(h));
  if (memcmp(h.magic, PYDB_MAGIC, sizeof(PYDB_MAGIC)) != 0) return PydbValidity::BadMagic;
  if (h.version != PYDB_VERSION) return PydbValidity::UnknownVersion;
  if (h.totalSize < PYDB_HEADER_SIZE || h.totalSize > partitionSize) return PydbValidity::SizeMismatch;
  totalSize = h.totalSize;
  return PydbValidity::Ok;
}

// Structural check plus CRC. `data` need not be aligned.
inline PydbValidity validatePydb(const uint8_t* data, const size_t size) {
  if (size < PYDB_HEADER_SIZE) return PydbValidity::TooSmall;
  PydbHeader h;
  memcpy(&h, data, sizeof(h));
  if (memcmp(h.magic, PYDB_MAGIC, sizeof(PYDB_MAGIC)) != 0) return PydbValidity::BadMagic;
  if (h.version != PYDB_VERSION) return PydbValidity::UnknownVersion;
  if (h.totalSize != size) return PydbValidity::SizeMismatch;

  const uint64_t total = size;
  const bool countsSane =
      h.codepointCount > 0 && h.codepointCount <= PYDB_MAX_CODEPOINTS && h.groupCount > 0 &&
      h.groupCount <= PYDB_MAX_GROUPS && h.readingCount <= PYDB_MAX_READINGS && h.syllableCount > 0 &&
      h.syllableCount <= PYDB_MAX_SYLLABLES && h.imeCharCount <= PYDB_MAX_IME_CHARS &&
      h.phraseCount <= PYDB_MAX_PHRASES && h.syllablesLen <= PYDB_MAX_BLOB && h.phraseBlobLen <= PYDB_MAX_BLOB;
  if (!countsSane) return PydbValidity::SectionsInconsistent;

  const bool sectionsFit =
      detail::pydbRangeFits(h.codepointsOff, static_cast<uint64_t>(h.codepointCount) * 4, total) &&
      detail::pydbRangeFits(h.groupsOff, static_cast<uint64_t>(h.codepointCount) * 2, total) &&
      detail::pydbRangeFits(h.groupOffsetsOff, (static_cast<uint64_t>(h.groupCount) + 1) * 2, total) &&
      detail::pydbRangeFits(h.readingsOff, static_cast<uint64_t>(h.readingCount) * 2, total) &&
      detail::pydbRangeFits(h.syllableOffsetsOff, (static_cast<uint64_t>(h.syllableCount) + 1) * 2, total) &&
      detail::pydbRangeFits(h.syllablesOff, h.syllablesLen, total) &&
      detail::pydbRangeFits(h.imeOffsetsOff, (static_cast<uint64_t>(h.syllableCount) + 1) * 4, total) &&
      detail::pydbRangeFits(h.imeCharsOff, static_cast<uint64_t>(h.imeCharCount) * 2, total) &&
      detail::pydbRangeFits(h.phraseOffsetsOff, (static_cast<uint64_t>(h.phraseCount) + 1) * 4, total) &&
      detail::pydbRangeFits(h.phraseBlobOff, h.phraseBlobLen, total);
  if (!sectionsFit) return PydbValidity::SectionsInconsistent;

  // Both string blobs are scanned with memchr/strcmp bounded only by their
  // length, so a missing final terminator would run a lookup off the end of
  // the image. Require it once, here.
  if (h.syllablesLen > 0 && data[h.syllablesOff + h.syllablesLen - 1] != 0) return PydbValidity::SectionsInconsistent;
  if (h.phraseBlobLen > 0 && data[h.phraseBlobOff + h.phraseBlobLen - 1] != 0) return PydbValidity::SectionsInconsistent;

  const uint32_t expectCrc = pydbCrc32WithFieldZeroed(data, size);
  if (expectCrc != h.crc32) return PydbValidity::BadCrc;
  return PydbValidity::Ok;
}

}  // namespace pinyin
