#pragma once

// On-flash layout of the data-partition language pack (`JILP`), plus every
// check a reader runs before trusting a byte of it.
//
// Generated by scripts/gen_i18n.py into build/i18n_pack.dat and written to the
// data/spiffs partition by exp/flash_device.sh. Only CROSSPOINT_I18N_PACK
// builds reference it; every other target keeps all language blobs in the
// image.
//
// Why the pack is signed three ways: the blob of a language is nothing but
// strings concatenated with NULs, and the offset table is rebuilt on the device
// from a same-as-English bitmap. A pack built from a different translation set
// would still parse -- and would silently return the wrong string for every
// key. Magic/version alone cannot catch that, so the header also records how
// many keys the pack was built for, an FNV-1a fingerprint of their names in
// StrId order, and an FNV-1a fingerprint of every translation value in key
// order (then language order). The first two catch a changed key set; the third
// catches a pack built from the same keys but edited text, which is exactly what
// an OTA that ships only the data partition produces. A mismatch of any of them
// rejects the whole pack and the UI falls back to English; it is never
// partially trusted.
//
// The value fingerprint is compared against I18N_CONTENT_SIGNATURE, a constant
// the generator bakes into I18nKeys.h from the same YAML that builds the
// firmware image. The device cannot recompute it from its own tables: it holds
// only the embedded languages. That is why it is a header field and not a
// recomputation.
//
// Layout, little-endian, every blob and bitmap 4-byte aligned:
//
//   header   64 bytes (Header)
//   index    languageCount * 32 bytes (Entry)
//   data     each language's blob, then its same-as-English bitmap
//
// Deliberately free of HAL and ESP headers so the format can be validated on
// the host. The partition reader lives in I18nPack.cpp.

#include <cstddef>
#include <cstdint>
#include <cstring>

namespace i18n_pack {

inline constexpr char I18N_PACK_MAGIC[4] = {'J', 'I', 'L', 'P'};
// v2 added contentSignature (offset 36, formerly the first reserved word). A v1
// pack is rejected as BadVersion rather than read with a zero signature.
inline constexpr uint8_t I18N_PACK_VERSION = 2;
inline constexpr size_t I18N_PACK_HEADER_SIZE = 64;
inline constexpr size_t I18N_PACK_ENTRY_SIZE = 32;
inline constexpr size_t I18N_PACK_INDEX_OFFSET = I18N_PACK_HEADER_SIZE;

// Caps, not expectations: they bound the arithmetic so a corrupt header cannot
// make the loader allocate or read an absurd amount. Thirty-three languages
// ship today; offsets are 15-bit, so a blob can never exceed 32,767 bytes.
inline constexpr uint32_t I18N_PACK_MAX_ENTRIES = 64;
inline constexpr uint32_t I18N_PACK_MAX_ENTRY_BYTES = 0x7FFF;
inline constexpr uint32_t I18N_PACK_MAX_KEYS = 32768;
inline constexpr uint32_t I18N_PACK_MAX_BITMAP_BYTES = (I18N_PACK_MAX_KEYS + 7) / 8;
inline constexpr size_t I18N_PACK_MAX_TOTAL = 1u << 23;

// Only bit 0 is defined today. An embedded entry would mean "this language's
// blob is in the firmware image", which the generator does not emit (EN and
// ZH are simply absent from the pack), but the flag keeps the door open
// without a format change.
inline constexpr uint16_t I18N_PACK_FLAG_EMBEDDED = 0x0001;

enum class Validity : uint8_t {
  Ok = 0,
  NoPartition,
  PartitionRead,
  PsramStack,
  TooSmall,
  BadMagic,
  BadVersion,
  HeaderSize,
  HeaderCrc,
  KeyCount,
  KeySignature,
  ContentSignature,
  LanguageCount,
  TotalSize,
  IndexBounds,
  BadIndexCrc,
  EntryBounds,
  DuplicateLanguage,
  BadLanguageId,
  BadBlobCrc,
  BadBitmapCrc,
  BlobTooLarge,
  BitmapSize,
  LanguageAbsent,
  OutOfMemory,
};

inline const char* validityName(Validity value) {
  switch (value) {
    case Validity::Ok: return "ok";
    case Validity::NoPartition: return "no data partition";
    case Validity::PartitionRead: return "partition read failed";
    case Validity::PsramStack: return "refused on a PSRAM-stack task";
    case Validity::TooSmall: return "shorter than a header";
    case Validity::BadMagic: return "not a language pack (bad magic)";
    case Validity::BadVersion: return "unsupported pack version";
    case Validity::HeaderSize: return "header or entry size mismatch";
    case Validity::HeaderCrc: return "header CRC mismatch";
    case Validity::KeyCount: return "built for a different number of keys";
    case Validity::KeySignature: return "built for a different key set";
    case Validity::ContentSignature: return "built from different translation text";
    case Validity::LanguageCount: return "implausible language count";
    case Validity::TotalSize: return "pack size disagrees with the partition";
    case Validity::IndexBounds: return "index extends past the pack";
    case Validity::BadIndexCrc: return "index CRC mismatch";
    case Validity::EntryBounds: return "an entry points outside the pack";
    case Validity::DuplicateLanguage: return "duplicate language in the index";
    case Validity::BadLanguageId: return "language id outside this build's enum";
    case Validity::BadBlobCrc: return "string blob CRC mismatch";
    case Validity::BadBitmapCrc: return "bitmap CRC mismatch";
    case Validity::BlobTooLarge: return "string blob exceeds the 15-bit offset limit";
    case Validity::BitmapSize: return "bitmap size disagrees with the key count";
    case Validity::LanguageAbsent: return "language not present in the pack";
    case Validity::OutOfMemory: return "PSRAM allocation failed";
  }
  return "unknown";
}

#pragma pack(push, 1)
struct Header {
  char magic[4];
  uint8_t version;
  uint8_t headerSize;
  uint16_t flags;
  // Number of StrId entries and FNV-1a of their names in enum order, NUL
  // included. Both must match the compiled I18nKeys.h.
  uint32_t keyCount;
  uint32_t keySignature;
  uint16_t languageCount;
  uint16_t entrySize;
  uint32_t indexOffset;
  // CRC-32 (IEEE, reflected -- the value zlib.crc32 produces) over the index
  // bytes, and over this header with headerCrc32 read as zero. Hashing the
  // index is what makes a reordered or truncated language table detectable
  // rather than merely odd.
  uint32_t indexCrc32;
  uint32_t headerCrc32;
  uint32_t totalSize;
  // FNV-1a of every translation value, key order then language order, each
  // string NUL-terminated. Must equal I18N_CONTENT_SIGNATURE in I18nKeys.h.
  // 0 in a v1 pack, which is why v1 is not accepted under this version.
  uint32_t contentSignature;
  uint8_t reserved[24];
};

struct Entry {
  uint16_t langId;  // Language enum ordinal in the firmware that wrote the pack
  uint16_t flags;
  uint32_t blobOff;  // absolute pack offset, 4-byte aligned
  uint32_t blobSize;
  uint32_t blobCrc32;
  uint32_t bitmapOff;  // absolute pack offset, 4-byte aligned
  uint32_t bitmapSize;
  uint32_t bitmapCrc32;
  uint32_t reserved;
};
#pragma pack(pop)

static_assert(sizeof(Header) == I18N_PACK_HEADER_SIZE, "Header must stay 64 bytes");
static_assert(sizeof(Entry) == I18N_PACK_ENTRY_SIZE, "Entry must stay 32 bytes");

// Byte-at-a-time reflected CRC-32 (IEEE 802.3, the polynomial zlib uses), so
// the generator's zlib.crc32 and this agree without either side carrying a
// table. The largest blob hashed here is ~16 KB once per language switch, so
// a 1 KiB lookup table would cost more than it saves.
inline uint32_t crc32(const uint8_t* data, size_t size, uint32_t running = 0xFFFFFFFFu) {
  for (size_t i = 0; i < size; ++i) {
    running ^= data[i];
    for (int bit = 0; bit < 8; ++bit) {
      running = (running >> 1) ^ (0xEDB88320u & (0u - (running & 1u)));
    }
  }
  return running;
}

inline uint32_t crc32Final(uint32_t running) { return running ^ 0xFFFFFFFFu; }

inline uint32_t headerCrc(const Header& header) {
  Header copy;
  memcpy(&copy, &header, sizeof(copy));
  copy.headerCrc32 = 0;
  return crc32Final(crc32(reinterpret_cast<const uint8_t*>(&copy), sizeof(copy)));
}

// Header validation. `available` is how many bytes the caller actually holds;
// `partitionBytes` is how much room remains in the data partition from the
// pack's offset. `expectedKeyCount`/`expectedKeySignature` come from the
// compiled I18nKeys.h; so does `expectedContentSignature`, which catches a pack
// rebuilt from edited translations with an unchanged key set.
//
// Order matters for the reported reason: cheap structural checks first, then
// the header CRC, and only then the build-identity comparison. A pack written
// by a different firmware has a valid CRC and mismatching key fields, which is
// exactly the case that must not be confused with corruption.
inline Validity validateHeader(const uint8_t* data, size_t available, uint32_t partitionBytes,
                               uint32_t expectedKeyCount, uint32_t expectedKeySignature,
                               uint32_t expectedContentSignature, Header& out) {
  out = Header{};
  if (data == nullptr || available < I18N_PACK_HEADER_SIZE) return Validity::TooSmall;

  Header header;
  memcpy(&header, data, sizeof(header));
  if (memcmp(header.magic, I18N_PACK_MAGIC, sizeof(I18N_PACK_MAGIC)) != 0) return Validity::BadMagic;
  if (header.version != I18N_PACK_VERSION) return Validity::BadVersion;
  if (header.headerSize != I18N_PACK_HEADER_SIZE || header.entrySize != I18N_PACK_ENTRY_SIZE) {
    return Validity::HeaderSize;
  }
  if (header.languageCount == 0 || header.languageCount > I18N_PACK_MAX_ENTRIES) return Validity::LanguageCount;
  if (header.indexOffset != I18N_PACK_INDEX_OFFSET) return Validity::HeaderSize;

  const size_t indexBytes = static_cast<size_t>(header.languageCount) * I18N_PACK_ENTRY_SIZE;
  const size_t indexEnd = I18N_PACK_INDEX_OFFSET + indexBytes;
  // blobsOff-style trusting is avoided: the data section starts at the first
  // 4-byte boundary after the index, and every entry is checked against that.
  if (header.totalSize < indexEnd || header.totalSize > I18N_PACK_MAX_TOTAL) return Validity::TotalSize;
  if (header.totalSize > partitionBytes) return Validity::TotalSize;
  if (header.headerCrc32 != headerCrc(header)) return Validity::HeaderCrc;
  if (header.keyCount != expectedKeyCount) return Validity::KeyCount;
  if (header.keySignature != expectedKeySignature) return Validity::KeySignature;
  if (header.contentSignature != expectedContentSignature) return Validity::ContentSignature;

  out = header;
  return Validity::Ok;
}

inline size_t expectedBitmapBytes(uint32_t keyCount) { return (static_cast<size_t>(keyCount) + 7) / 8; }

// Which languages a pack build carries. English is always image-resident (every
// table points into it), and Chinese is image-resident only when the build
// compiles it in; the generator always leaves both out of the pack, so a build
// without embedded Chinese has no Chinese strings anywhere and the picker must
// treat it as unavailable rather than as "packed but English".
//
// Parameters instead of Language values so the host tests can exercise all four
// combinations without a second generated enum. I18nPack::isPacked() is the only
// caller in the firmware.
constexpr bool packedByContract(bool isEnglish, bool isChinese, bool embeddedChinese) {
  return !isEnglish && !(isChinese && embeddedChinese);
}

// Index validation. Every entry must describe a 4-aligned region wholly inside
// the pack, above the index, with the bitmap length implied by keyCount, and no
// two entries may share a language: a duplicate would make the loader's choice
// depend on index order, which a reader of the file cannot see.
//
// `languageLimit` is the firmware's Language::_COUNT. It is a parameter rather
// than an include so this header stays independent of the generated enum (and
// so a host test can compile it against a different I18nKeys.h without two
// definitions of that header colliding).
inline Validity validateIndex(const Header& header, const uint8_t* data, size_t available,
                              uint16_t languageLimit) {
  const size_t indexBytes = static_cast<size_t>(header.languageCount) * I18N_PACK_ENTRY_SIZE;
  if (data == nullptr || available < indexBytes) return Validity::IndexBounds;
  if (crc32Final(crc32(data, indexBytes)) != header.indexCrc32) return Validity::BadIndexCrc;

  const size_t indexEnd = I18N_PACK_INDEX_OFFSET + indexBytes;
  const size_t dataStart = (indexEnd + 3u) & ~static_cast<size_t>(3u);
  const size_t bitmapBytes = expectedBitmapBytes(header.keyCount);
  if (bitmapBytes > I18N_PACK_MAX_BITMAP_BYTES) return Validity::BitmapSize;

  for (uint32_t i = 0; i < header.languageCount; ++i) {
    Entry entry;
    memcpy(&entry, data + static_cast<size_t>(i) * I18N_PACK_ENTRY_SIZE, sizeof(entry));
    if (entry.langId >= languageLimit) return Validity::BadLanguageId;
    if ((entry.flags & ~I18N_PACK_FLAG_EMBEDDED) != 0) return Validity::EntryBounds;
    if (entry.blobSize > I18N_PACK_MAX_ENTRY_BYTES) return Validity::BlobTooLarge;
    if (entry.bitmapSize != bitmapBytes) return Validity::BitmapSize;
    if ((entry.blobOff & 3u) != 0 || (entry.bitmapOff & 3u) != 0) return Validity::EntryBounds;
    if (entry.blobOff < dataStart || entry.bitmapOff < dataStart) return Validity::EntryBounds;
    const uint64_t blobEnd = static_cast<uint64_t>(entry.blobOff) + entry.blobSize;
    const uint64_t bitmapEnd = static_cast<uint64_t>(entry.bitmapOff) + entry.bitmapSize;
    if (blobEnd > header.totalSize || bitmapEnd > header.totalSize) return Validity::EntryBounds;
    for (uint32_t j = 0; j < i; ++j) {
      Entry earlier;
      memcpy(&earlier, data + static_cast<size_t>(j) * I18N_PACK_ENTRY_SIZE, sizeof(earlier));
      if (earlier.langId == entry.langId) return Validity::DuplicateLanguage;
    }
  }
  return Validity::Ok;
}

inline bool findEntry(const uint8_t* index, uint32_t count, uint16_t langId, Entry& out) {
  for (uint32_t i = 0; i < count; ++i) {
    memcpy(&out, index + static_cast<size_t>(i) * I18N_PACK_ENTRY_SIZE, sizeof(out));
    if (out.langId == langId) return true;
  }
  return false;
}

inline Validity validateBlob(const Entry& entry, const uint8_t* data, size_t available) {
  if (data == nullptr && entry.blobSize != 0) return Validity::EntryBounds;
  if (available < entry.blobSize) return Validity::EntryBounds;
  if (entry.blobSize > I18N_PACK_MAX_ENTRY_BYTES) return Validity::BlobTooLarge;
  if (crc32Final(crc32(data, entry.blobSize)) != entry.blobCrc32) return Validity::BadBlobCrc;
  return Validity::Ok;
}

inline Validity validateBitmap(const Entry& entry, const uint8_t* data, size_t available) {
  if (data == nullptr || available < entry.bitmapSize) return Validity::EntryBounds;
  if (entry.bitmapSize > I18N_PACK_MAX_BITMAP_BYTES) return Validity::BitmapSize;
  if (crc32Final(crc32(data, entry.bitmapSize)) != entry.bitmapCrc32) return Validity::BadBitmapCrc;
  return Validity::Ok;
}

}  // namespace i18n_pack
